## boards/arm/mpw_sensor_board/Kconfig.board
```kconfig
# Copyright (c) 2023 Nordic Semiconductor ASA
# SPDX-License-Identifier: Apache-2.0

config BOARD_MPW_SENSOR_BOARD
	bool "mpw-sensor board"
	depends on SOC_NRF52840_QIAA
```

## boards/arm/mpw_sensor_board/Kconfig.defconfig
```kconfig
# Copyright (c) 2023 Nordic Semiconductor ASA
# SPDX-License-Identifier: Apache-2.0

if BOARD_MPW_SENSOR_BOARD

config BOARD
	default "mpw_sensor_board"

config BT_CTLR
   default BT

endif
```

## boards/arm/nrf52840_test_board/Kconfig.board
```kconfig
# Copyright (c) 2023 Nordic Semiconductor ASA
# SPDX-License-Identifier: Apache-2.0

config BOARD_NRF52840_TEST_BOARD
	bool "nrf52840 test board"
	depends on SOC_NRF52840_QIAA
```

## boards/arm/nrf52840_test_board/Kconfig.defconfig
```kconfig
# Copyright (c) 2023 Nordic Semiconductor ASA
# SPDX-License-Identifier: Apache-2.0

if BOARD_NRF52840_TEST_BOARD

config BOARD
	default "nrf52840_test_board"

config BT_CTLR
   default BT

endif
```
